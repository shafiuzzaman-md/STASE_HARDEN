## eval2_linux-asu/drivers/conv/Kconfig
```kconfig
menu "Conversion Driver"
config CONV_DRIVER
 bool "Conversion Driver Module"
 default y
endmenu
```

## eval2_linux-asu/drivers/kbdi/Kconfig
```kconfig
config KBDI
  default m
  tristate "USB keyboard driver"
  help
    USB keyboard driver
```

## eval2_linux-asu/drivers/kbmi_net/Kconfig
```kconfig
config KBMI_NET
  default m
  tristate "Keyboard Message Initializer Network"
  help
    Keyboard Message Initializer but on the net!
```

## eval2_linux-asu/drivers/kbmp/Kconfig
```kconfig
config KBMP
  default m
  tristate "Keyboard Message Programmer Module"
  help
    Keyboard Message Programmer.
```

## eval2_linux-asu/drivers/thermal_char_device/Kconfig
```kconfig
config THERMAL_CHAR_DEVICE
  default m
  tristate "Thermal Character Device Driver"
  help
    Thermal Character Device Driver - get that temperature.
```

## eval2_linux-main/drivers/evt_notifier/Kconfig
```kconfig
config EVT_NOTIFIER
  default m
  tristate "Device Event Notifer Driver Module"
  help
    Device Event Notifer Driver.
```

## eval2_linux-main/drivers/kbmi_usb/Kconfig
```kconfig
config KBMI_USB
  default m
  tristate "Keyboard Message Initializer USB"
  help
    Keyboard Message Initializer USB Device.
```

## eval2_linux-main/drivers/msg_qchar/Kconfig
```kconfig
config MSG_QCHAR
  default m
  tristate "Message Queue Character Device Driver"
  help
    Message Queue Character Device Driver.
```

## eval2_linux-main/drivers/rev_chardev/Kconfig
```kconfig
config REV_CHARDEV
  default m
  tristate "Reverse String Module Driver"
  help
    Reverse String Module Driver.
```

## eval2_linux-main/drivers/usb_event_logger/Kconfig
```kconfig
config USB_EVENT_LOGGER
  default m
  tristate "USB Device Event Logger"
  help
    USB Device Event Logger.
```

## eval2_linux-main/drivers/vnet_pktfilter/Kconfig
```kconfig
config VNET_PKTFILTER
  default m
  tristate "Virtual Network Packet Filter Kernel Module"
  help
    Virtual Network Packet Filter.
```
